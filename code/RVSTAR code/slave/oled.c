#include <gd32vf103v_rvstar.h>

#define OLED_CMD  0 
#define OLED_DATA 1

//12*12
const unsigned char asc2_1206[95][12]={
{0x00,0x00,0x00,0x00,0x00,0x00,0x00,0x00,0x00,0x00,0x00,0x00},/*" ",0*/
{0x00,0x00,0x00,0x00,0x3F,0x40,0x00,0x00,0x00,0x00,0x00,0x00},/*"!",1*/
{0x00,0x00,0x30,0x00,0x40,0x00,0x30,0x00,0x40,0x00,0x00,0x00},/*""",2*/
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{0x40,0x00,0x80,0x00,0x40,0x00,0x20,0x00,0x20,0x00,0x40,0x00},/*"~",94*/
};  
//16*16 
const unsigned char asc2_1608[95][16]={   
{0x00,0x00,0x00,0x00,0x00,0x00,0x00,0x00,0x00,0x00,0x00,0x00,0x00,0x00,0x00,0x00},/*" ",0*/
{0x00,0x00,0x00,0x00,0x00,0x00,0x1F,0xCC,0x00,0x0C,0x00,0x00,0x00,0x00,0x00,0x00},/*"!",1*/
{0x00,0x00,0x08,0x00,0x30,0x00,0x60,0x00,0x08,0x00,0x30,0x00,0x60,0x00,0x00,0x00},/*""",2*/
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{0x00,0x00,0x60,0x00,0x80,0x00,0x80,0x00,0x40,0x00,0x40,0x00,0x20,0x00,0x20,0x00},/*"~",94*/
};

const unsigned char asc2_2412[95][36];

uint8_t OLED_GRAM[128][8]; 

/*!
    \brief      initialize the OLED
    \param[in]  none
    \param[out] none
    \retval     none
*/
void OLED_init(void)
{
    /* configure GPIO */
    gpio_config();   
    /* configure SPI */
    SPI_config();
    /* put reset low */
    gpio_bit_reset(GPIOB, GPIO_PIN_9);
    delay_1ms(100);
    /* put reset high */
    gpio_bit_set(GPIOB, GPIO_PIN_9);

    OLED_WR_Byte(0xAE,OLED_CMD); /* display off */ 
    OLED_WR_Byte(0xD5,OLED_CMD); /* set the clock frequency division factor and oscillation frequency */
    OLED_WR_Byte(80,OLED_CMD);   /* clock frequency division factor:[3:0], oscillation frequency:[4:0] */
    OLED_WR_Byte(0xA8,OLED_CMD); /* set the drive number */
    OLED_WR_Byte(0X3F,OLED_CMD); /* default: 0x3f */
    OLED_WR_Byte(0xD3,OLED_CMD); /* default: 0x3f */
    OLED_WR_Byte(0X00,OLED_CMD); /* set display offset */

    OLED_WR_Byte(0x40,OLED_CMD); /* set the display start line, [5:0] */
													    
    OLED_WR_Byte(0x8D,OLED_CMD); /* set charge pump */
    OLED_WR_Byte(0x14,OLED_CMD); /* bit2, on/off */
    OLED_WR_Byte(0x20,OLED_CMD); /* set the memory address mode */
    OLED_WR_Byte(0x02,OLED_CMD); /* [1:0],00 ,column address mode; 01, row address mode; 10, page address mode; default 10*/
    OLED_WR_Byte(0xA1,OLED_CMD); /* set section redefine,bit0:0,0->0;1,0->127 */
    OLED_WR_Byte(0xC0,OLED_CMD); /* set the COM scan direction;bit3:0,normal mode; redeifne mode COM[N-1]->COM0;N: drive number*/
    OLED_WR_Byte(0xDA,OLED_CMD); /* set the COM hardware pin configuration*/
    OLED_WR_Byte(0x12,OLED_CMD); /* configure [5:4]*/
		 
    OLED_WR_Byte(0x81,OLED_CMD); /* set contrast */
    OLED_WR_Byte(0xEF,OLED_CMD); /* 1-255,default:0x7F(brightness setting, the bigger, the brighter*/
    OLED_WR_Byte(0xD9,OLED_CMD); /* set the pre-charge cycle */
    OLED_WR_Byte(0xf1,OLED_CMD); /* [3:0],PHASE 1;[7:4],PHASE 2; */
    OLED_WR_Byte(0xDB,OLED_CMD); /* set VCOMH voltage multiplier */
    OLED_WR_Byte(0x30,OLED_CMD); /* [6:4] 000,0.65*vcc;001,0.77*vcc;011,0.83*vcc; */

    OLED_WR_Byte(0xA4,OLED_CMD); /* set global display; bit0:1,on;0,off(white/black screen)*/
    OLED_WR_Byte(0xA6,OLED_CMD); /* set the display mode; bit0:1,reverse display ; 0, normal display*/						   
    OLED_WR_Byte(0xAF,OLED_CMD); /* display on */
    OLED_Clear();
}

/*!
    \brief      configure the GPIO peripheral
    \param[in]  none
    \param[out] none
    \retval     none
*/
void gpio_config(void)
{
    /* enable GPIOB,AF clock */
    rcu_periph_clock_enable(RCU_GPIOB);
    rcu_periph_clock_enable(RCU_AF);

    /* PB8/DC and CS PB9/RST */
    gpio_init(GPIOB, GPIO_MODE_OUT_PP, GPIO_OSPEED_50MHZ, GPIO_PIN_8 | GPIO_PIN_9);
}

/*!
    \brief      configure the SPI peripheral
    \param[in]  none
    \param[out] none
    \retval     none
*/
void SPI_config(void)
{    
    spi_parameter_struct spi_init_struct;
    /* deinitilize SPI and the parameters */
    spi_i2s_deinit(SPI0);
    spi_struct_para_init(&spi_init_struct);

    /* SPI0 parameter config */
    spi_init_struct.trans_mode           = SPI_TRANSMODE_FULLDUPLEX;
    spi_init_struct.device_mode          = SPI_MASTER;
    spi_init_struct.frame_size           = SPI_FRAMESIZE_8BIT;
    spi_init_struct.clock_polarity_phase = SPI_CK_PL_HIGH_PH_2EDGE;
    spi_init_struct.nss                  = SPI_NSS_SOFT;
    spi_init_struct.prescale             = SPI_PSC_64;
    spi_init_struct.endian               = SPI_ENDIAN_MSB;
    spi_init(SPI0, &spi_init_struct);
    
    /* SPI enable */
    spi_enable(SPI0);
}

/**
    \brief      1us delay function
    \param[in]  none
    \param[out] none
    \retval     none
*/
void delay_us(uint16_t n)
{
    uint8_t i;

    while(n--) {
        for (i = 0; i < 15; i++) {
            __asm("NOP");
        }
    }
}

/**
    \brief      Write data
    \param[in]  none
    \param[out] none
    \retval     none
*/
void OLED_WR_Byte(uint8_t dat,uint8_t cmd)
{
    /* DC/cmd:  1 means data,0 means command */
    if( cmd ) {
        gpio_bit_set(GPIOB, GPIO_PIN_8);
    } else { 
        gpio_bit_reset(GPIOB, GPIO_PIN_8);
    }
    /* wait until the transmit data buffer is empty */
    while(RESET == spi_i2s_flag_get(SPI0, SPI_FLAG_TBE));
    /* SPI transmit data */
    spi_i2s_data_transmit(SPI0, dat);

    delay_us(10);
    /* DC = 1 */
    gpio_bit_set(GPIOB, GPIO_PIN_8);
}

/**
    \brief      Clear the OLED
    \param[in]  none
    \param[out] none
    \retval     none
*/
void OLED_Clear(void)  
{  
    uint8_t i,n;  
    for( i = 0; i < 8; i++) 
        for( n = 0; n < 128; n++)
            OLED_GRAM[n][i] = 0x00;  
    OLED_Refresh_Gram();
}

/**
    \brief      Update memory to the OLED
    \param[in]  none
    \param[out] none
    \retval     none
*/
void OLED_Refresh_Gram(void)
{
    uint8_t i,n;    
    for( i = 0; i < 8; i++) {
	OLED_WR_Byte (0xb0+i,OLED_CMD); /* set page address (0-7) */ 
	OLED_WR_Byte (0x00,OLED_CMD);   /* set display location - column low address */  
	OLED_WR_Byte (0x10,OLED_CMD);   /* set display location - column high address */   
	for(n = 0; n < 128; n++) OLED_WR_Byte(OLED_GRAM[n][i],OLED_DATA); 
    } 
}

/**
    \brief      OLED display on
    \param[in]  none
    \param[out] none
    \retval     none
*/ 
void OLED_Display_On(void)
{
    OLED_WR_Byte(0x8D,OLED_CMD);  
    OLED_WR_Byte(0x14,OLED_CMD); 
    OLED_WR_Byte(0xAF,OLED_CMD); 
}

/**
    \brief      OLED display off
    \param[in]  none
    \param[out] none
    \retval     none
*/      
void OLED_Display_Off(void)
{
    OLED_WR_Byte(0x8D,OLED_CMD);  
    OLED_WR_Byte(0x10,OLED_CMD);
    OLED_WR_Byte(0xAE,OLED_CMD);
}

 /*!
    \brief      Write a pixel data at a specified location
    \param[in]  x:the x coordinate of the pixel(0~127)
                y:the y coordinate of the pixel(0~63)
                t:mode
    \param[out] none
    \retval     none
*/			   
void OLED_DrawPoint(uint8_t x, uint8_t y, uint8_t t)
{
    uint8_t pos,bx,temp = 0;
    if(x > 127|| y > 63) return;
    pos = 7 - y / 8;
    bx = y % 8;
    temp = 1 << ( 7 - bx );
    if(t) OLED_GRAM[x][pos] |= temp;
    else OLED_GRAM[x][pos] &=~temp;	    
}

 /*!
    \brief      fill the specified area
    \param[in]  x1:the bebinning x coordinate of the specified area
                y1:the bebinning y coordinate of the specified area
                x2:the ending x coordinate of the specified area
                y2:the ending y coordinate of the specified area
    \param[out] none
    \retval     none
*/  
void OLED_Fill(uint8_t x1, uint8_t y1, uint8_t x2, uint8_t y2, uint8_t dot)  
{  
    uint8_t x, y;  
    for(x = x1; x <= x2; x++) {
	for(y = y1; y <= y2; y++) OLED_DrawPoint(x, y, dot);
    }													    
    OLED_Refresh_Gram();
}

/*!
    \brief      Display a single English character
    \param[in]  x:the bebinning x coordinate of the Character display position
                y:the bebinning y coordinate of the Character display position
                fc:the color value of display character
                bc:the background color of display character
                num:the ascii code of display character(0~94)
                size:the size of display number
                mode:0-no overlying,1-overlying
    \param[out] none
    \retval     none
*/
void OLED_ShowChar(uint8_t x, uint8_t y, uint8_t chr, uint8_t size, uint8_t mode)
{      			    
    uint8_t temp, t, t1;
    uint8_t y0 = y;
    uint8_t csize = ( size / 8 + ( ( size % 8 ) ? 1 : 0) ) *  ( size / 2);
    chr = chr-' ';	 
    for(t = 0;t < csize;t++) {
	if(size == 12) temp = asc2_1206[chr][t];
	else if(size == 16) temp = asc2_1608[chr][t];
	else if(size == 24) temp = asc2_2412[chr][t];
	else return;
        for(t1 = 0; t1 < 8; t1++) {
            if(temp & 0x80) OLED_DrawPoint(x, y, mode);
            else OLED_DrawPoint(x, y, !mode);
            temp <<= 1;
            y++;
            if((y-y0) == size) {
		y = y0;
		x++;
		break;
            }
	}  	 
    }          
}

 /*!
    \brief      get the nth power of m (internal call)
    \param[in]  m:the multiplier
                n:the power
    \param[out] none
    \retval     the nth power of m
*/
uint32_t mypow(uint8_t m, uint8_t n)
{
    uint32_t result = 1;	 
    while( n-- ) result *= m;    
    return result;
}				  

 /*!
    \brief      Display number
    \param[in]  x:the bebinning x coordinate of the number
                y:the bebinning y coordinate of the number
                num:the number(0~4294967295)
                len:the length of the display number
                size:the size of display number
    \param[out] none
    \retval     none
*/ 		  
void OLED_ShowNum(uint8_t x, uint8_t y,uint32_t num, uint8_t len, uint8_t size)
{         	
    uint8_t t,temp;
    uint8_t enshow=0;						   
    for(t = 0;t < len;t++) {
	temp = ( num / mypow(10, len-t-1) )%10;
        if( enshow == 0 && t < (len-1) ) {
            if(temp == 0) {
                OLED_ShowChar(x + ( size / 2 ) * t, y, ' ', size, 1);
                continue;
            } else enshow = 1; 
        }
        OLED_ShowChar(x + ( size / 2 ) * t, y, temp + '0', size, 1); 
    }
} 

 /*!
    \brief      Display English string
    \param[in]  x:the bebinning x coordinate of the English string
                y:the bebinning y coordinate of the English string
                p:the start address of the English string
                size:the size of display character
    \param[out] none
    \retval     none
*/
void OLED_ShowString(uint8_t x, uint8_t y, const uint8_t *p, uint8_t size)
{	
    while(( *p <= '~') && ( *p >= ' ')) {       
        if( x > ( 128-( size / 2 ) ) ) {
            x = 0;
            y += size;
        }
        if( y > ( 64 - size ) ) {
            y = x = 0;
            OLED_Clear();
        }
        OLED_ShowChar( x, y, *p, size, 1 );	 
        x += size / 2;
        p++;
    }
}